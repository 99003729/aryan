/*@!Encoding:1252*/
includes
{
  
}

variables
{
  message DomeLights dl;
  message DoorStatus ds;
  message AccelerationMSG accl;
  message CruiseMSG cc;
  message Cruise_Control_Light ccl;
}
on start
{
dl.DomeSignal=0;
}
on message DoorStatus
{
if(this.Lock_UnlockKey==1)
{
 dl.DomeSignal=1;
  output(dl);
}
else
{
  dl.DomeSignal=0;
  output(dl);
}
}
on message CruiseMSG
{
  if(this.CruiseStatus==1)
  {
    ccl.cruise_light=1;
    output(ccl);
  }
  else
  {
    ccl.cruise_light=0;
    output(ccl);
  }
}


